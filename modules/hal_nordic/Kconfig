## modules/hal_nordic/Kconfig
```kconfig
# Copyright (c) 2016-2021 Nordic Semiconductor ASA
# SPDX-License-Identifier: Apache-2.0

config ZEPHYR_HAL_NORDIC_MODULE
	bool

rsource "nrfx/Kconfig"
```

## samples/boards/nrf/ieee802154/802154_rpmsg/boards/nrf5340dk_nrf5340_cpuapp.conf
```kconfig
CONFIG_NRF_802154_RADIO_DRIVER=n
CONFIG_BOARD_ENABLE_CPUNET=y
CONFIG_NRF_802154_SER_HOST=y
CONFIG_OPENAMP_SLAVE=n
CONFIG_ENTROPY_GENERATOR=y
CONFIG_XOROSHIRO_RANDOM_GENERATOR=y
CONFIG_NRFX_RNG=n
```
